## scripts/extra/qemu/Kconfig
```kconfig
menu "QEMU Options"

# The options in this file should never be referenced inside the kernel
# They are for configuring the "helper" command "make qemu" and "make qemu-gdb"
# which tries to run the kernel inside the QEMU virtual machine.

config QEMU_NUM_CPUS
    int "Number of CPU(s)"
    default 2
    help
      The number of SMP CPU(s) to run QEMU with.

config QEMU_MEMORY_GB
    int "GB of Memory"
    default 4
    help
      Number of GB of memory to give the VM.

config QEMU_NO_DISPLAY
    bool "Disable the QEMU display"
    default y
    help
      Do not open a monitor window when running the VM.


menu "QEMU Devices"

config QEMU_NVME_DRIVE
    bool "Add an NVME Drive"
    help
      Add an NVME driver to the QEMU options passed to the kernel
      Note: Does not enable the NVME driver. Please enable CONFIG_NVME.

config QEMU_NVME_DRIVE_FILE_PATH
    string "NVME Backing File Path"
    default "./disk.img"
    depends on QEMU_NVME_DRIVE
    help
      Path to a file to be used as the backing filesystem for the NVME drive.

endmenu

menu "GDB Server Options"

config QEMU_GDB_SERVER_PORT
    int "GDB Server Port"
    default 1234
    help
      Which port to open a GDB server on when running "make qemu-gdb"

config QEMU_GDB_BOOT_PAUSE
    bool "Wait for GDB Client On Boot"
    default n
    help
      Pass qemu the "-S" option which stops the VM from running any instructions
      at boot until the client connects and tells it to continue.
      Useful for debugging issues in the extremely early boot process.


endmenu

endmenu
```

## src/dev/Kconfig
```kconfig
menu "Devices"

menu "Serial Options"

config SERIAL_REDIRECT
    bool "Serial Redirect"
    depends on !HVM_HRT && ARCH_X86 && !PC_8250_UART
    default n
    help
        Redirect printing to serial device
        Uses early serial output at boot and then
        switches to ordinary serial interface afterwards
        What specifically is printed to serial also depends
        on how mirroring is set up (if at all) in the 
        virtual console configuration

config SERIAL_REDIRECT_PORT
    depends on SERIAL_REDIRECT
    int "Serial COM Port for redirection"
    range 1 4
    default "1"
    help
      Specifies which serial port to use for serial redirection. E.g. 1 is COM1.
      This must be different from your debug port!

config SERIAL_DEBUGGER
    bool "Serial Debugger"
    depends on ENABLE_REMOTE_DEBUGGING && ARCH_X86 && !PC_8250_UART
    default n
    help
        Provide a simple serial interface to a remote debugger

config SERIAL_DEBUGGER_PORT
    depends on SERIAL_DEBUGGER
    int "Serial COM Port for remote debugger interface"
    range 1 4
    default "2"
    help
      Specifies which serial port to use for serial connection to 
      a remote debugger (e.g. gdb).   1 is COM1, etc.  This must
      be different from your redirect port!
      
endmenu      

config SIFIVE_GPIO
    bool "SiFive GPIO"
    depends on ARCH_RISCV
    default y
    help
       Enable driver for SiFive GPIO

config SIFIVE_PLIC
    bool "SiFive Platform Level Interrupt Controller"
    depends on ARCH_RISCV
    help
      Provide a driver for the RISC-V Platform Level Interrupt Controller (PLIC)

config DEBUG_SIFIVE_PLIC
    bool "Debug SiFive Platform Level Interrupt Controller"
    depends on DEBUG_PRINTS && SIFIVE_PLIC
    help
      Debug the RISC-V Platform Level Interrupt Controller (PLIC)

config ARM_GIC
    bool "ARM Generic Interrupt Controller Driver"
    depends on ARCH_ARM64
    default y
    help
      Provide a driver for the ARM Generic Interrupt Controller (GIC)

choice 
    prompt "GIC Version"
    depends on ARCH_ARM64 && ARM_GIC
    default GIC_VERSION_2M

    config GIC_VERSION_2
      bool "Arm GICv2"

    config GIC_VERSION_2M
      bool "Arm GICv2m"
      select HAS_MSI
      
    config GIC_VERSION_3
      bool "Arm GICv3"
      select HAS_MSI

endchoice

config DEBUG_GIC
    bool "Debug GIC"
    depends on ARCH_ARM64 && ARM_GIC
    default n
    help
      Debug the Generic Interrupt Controller for the ARM64 Architecture

config GENERIC_8250_UART
    bool
    default n
    help
      Include a base 8250 UART implementation which can be used by other UART drivers

config DEBUG_GENERIC_8250_UART
    bool
    default n
    help
      Debug the generic 8250 UART implementation

config OF_8250_UART
    bool "Generic OF 8250 UART"
    depends on USE_FDT
    select GENERIC_8250_UART
    default n
    help
      Driver for Generic NS8250 UART found in the device tree, see 
      Linux's "linux/Documentation/device-tree/bindings/tty/serial/of-serial.txt" for the exact binding

config DEBUG_OF_8250_UART
    bool "Debug Generic OF 8250 UART"
    depends on DEBUG_PRINTS && OF_8250_UART
    default n
    help
      Debug the generic device tree NS8250 UART driver

config OF_8250_UART_EARLY_OUTPUT
    bool "Generic OF 8250 UART Early Output"
    depends on OF_8250_UART
    default n
    help
      Try to use the Generic 8250 UART found in the device tree for early output before the Virtual Console

config PC_8250_UART
    bool "PC 8250 UART"
    depends on ARCH_X86 && !STANDALONE_SERIAL_DRIVER
    select GENERIC_8250_UART
    default n
    help
      Driver for PC serial ports based on the generic 8250 framework in Nautilus.
      Selecting this disables the original serial port driver.

config DEBUG_PC_8250_UART
    bool "Debug PC 8250 UART"
    depends on DEBUG_PRINTS && PC_8250_UART
    select DEBUG_GENERIC_8250_UART

config PC_8250_UART_EARLY_OUTPUT
    bool "PC 8250 UART Early Output"
    depends on PC_8250_UART
    default n
    help
      Use one of the PC COM Ports for Early Output

config PC_8250_UART_EARLY_COM_PORT
    int "PC 8250 UART Early COM Port"
    depends on PC_8250_UART_EARLY_OUTPUT
    default 1
    help
      Specify which COM port should be used for early output

config DW_8250_UART
    bool "DesignWare UART"
    depends on USE_FDT
    select GENERIC_8250_UART
    default n
    help
      Driver for the Designware Serial UART

config DW_8250_UART_EARLY_OUTPUT
    bool "DesignWare UART Early Output"
    depends on DW_8250_UART
    default n
    help
      Register the DesignWare 8250 UART for output before the virtual console system is active

config DEBUG_DW_8250_UART
    bool "Debug DesignWare UART"
    depends on DEBUG_PRINTS && DW_8250_UART
    select DEBUG_GENERIC_8250_UART
    default n
    help
      Debug the DesignWare UART Driver

config PL011_UART
    bool "PL011 UART"
    depends on ARCH_ARM64 && USE_FDT
    default n
    help
      Include support for the Primecell PL011 UART

config PL011_UART_EARLY_OUTPUT
    bool "PL011 Early Output"
    depends on PL011_UART
    default n
    help
      Register the PL011 for output before the virtual console system is active

config DEBUG_PL011_UART
    bool "Debug PL011 UART"
    depends on PL011_UART && DEBUG_PRINTS
    default n
    help
      Turn on debug prints for the Primecell PL011 UART

config SIFIVE_SERIAL
    bool "SiFive Serial"
    depends on ARCH_RISCV && USE_FDT
    default n
    help
      Include driver for SiFive Serial Port

config SIFIVE_SERIAL_EARLY_OUTPUT
    bool "SiFive Serial Early Output"
    depends on SIFIVE_SERIAL
    default n
    help
      Register the SiFive serial port for output before the virtual console system is active

config SIFIVE_SERIAL_DEBUG
    bool "Debug SiFive Serial"
    depends on SIFIVE_SERIAL && DEBUG_PRINTS
    default n
    help
      Debug the driver for the SiFive serial port

config APIC_FORCE_XAPIC_MODE
    bool "Force APIC to use XAPIC mode"
    depends on ARCH_X86
    default n
    help
       Force the use of XAPIC mode even if X2APIC mode is available

config APIC_TIMER_CALIBRATE_INDEPENDENTLY
    bool "Calibrate APIC timer independently on each core"
    depends on ARCH_X86
    default n
    help
      If set, each core's APIC timer is independently calibrated
      If not set, only the BSP core's timer is calibrated and
      other cores clone its calibration


config DEBUG_APIC
    bool "Debug APIC"
    depends on ARCH_X86 && DEBUG_PRINTS
    default n
    help
        Turn on debug prints for the LAPIC driver

config DEBUG_IOAPIC
    bool "Debug IOAPIC"
    depends on ARCH_X86 && DEBUG_PRINTS
    default n
    help 
        Turn on debug prints for the IOAPIC driver

config OF_PCI
    bool "OpenFirmware PCI Bus"
    depends on USE_FDT && HAS_PCI
    default y
    help
        Allow parsing PCI information from the device tree if available.

config DEBUG_PCI
    bool "Debug PCI"
    depends on HAS_PCI && DEBUG_PRINTS
    default n
    help 
        Turn on debug prints for PCI devices

config DISABLE_PS2_MOUSE
    bool "Disable PS2 Mouse"
    default n
    help
        Unconditionally disable PS2 mouse support
        This is useful on bizarro platforms that have broken or
        disabled PS2 emulation where we can't detect it

config DEBUG_PS2
    bool "Debug PS2 interface (Keyboard/Mouse)"
    depends on ARCH_X86 && DEBUG_PRINTS
    default n
    help
        Turn on debug prints for the keyboard/mouse on the PS/2 interface

config PARALLEL_PORT_GPIO
    bool "Parallel Port GPIO Support"
    depends on ARCH_X86
    default n
    help
       Provide parallel port GPIO device driver

config PARALLEL_PORT_GPIO_PORT
    hex "Port"
    default 0xe010
    depends on PARALLEL_PORT_GPIO
    help
       Parallel port I/O port to use
       Common: 0x378  = first legacy parallel port
               0x278  = second legacy parallel port
               0xd010 = port in NU test Phi (lspci to find out)

config DEBUG_PARALLEL_PORT_GPIO
    bool "Debug GPIO interface (parallel port)"
    depends on DEBUG_PRINTS && PARALLEL_PORT_GPIO
    default n
    help
        Turn on debug prints for the parallel port GPIO device

config DEBUG_PIT
    bool "Debug PIT"
    depends on ARCH_X86 && DEBUG_PRINTS
    default n
    help
      Turn on debug prints for the i8253/8254 PIT

config HPET
    bool "HPET Support"
    depends on ARCH_X86
    default n
    help
      Includes HPET timer support in Nautilus

config DEBUG_HPET
    bool "Debug HPET"
    depends on DEBUG_PRINTS && HPET
    default n
    help
      Turn on debug prints for the HPET

config VIRTIO_PCI
    bool "Core Virtio PCI Driver"
    depends on HAS_PCI && HAS_MSI
    default n
    help
      Adds the basic Virtio PCI interface

config DEBUG_VIRTIO_PCI
    bool "Debug Virtio PCI"
    depends on DEBUG_PRINTS && VIRTIO_PCI
    default n
    help
      Turn on debug prints for the Virtio PCI interface

config VIRTIO_NET
    bool "Virtio Net"
    depends on VIRTIO_PCI
    default n
    help
      Adds the Virtio Network Driver

config DEBUG_VIRTIO_NET
    bool "Debug Virtio Net"
    depends on DEBUG_PRINTS && VIRTIO_NET
    default n
    help
      Turn on debug prints for the Virtio Network Driver
      
config VIRTIO_BLK
    bool "Virtio Block"
    depends on VIRTIO_PCI
    default n
    help
      Adds the Virtio Block Driver

config DEBUG_VIRTIO_BLK
    bool "Debug Virtio Block"
    depends on DEBUG_PRINTS && VIRTIO_BLK
    default n
    help
      Turn on debug prints for the Virtio Block Driver

config E1000_PCI
    bool "E1000 PCI NIC Driver"
    depends on HAS_PCI
    default n
    help
      Adds the basic E1000 PCI network interface driver

config DEBUG_E1000_PCI
    bool "Debug E1000 PCI"
    depends on DEBUG_PRINTS && E1000_PCI
    default n
    help
      Turn on debug prints for the E1000 PCI driver

config E1000E_PCI
    bool "E1000E PCI NIC Driver"
    depends on HAS_PCI
    default n
    help
      Adds the basic E1000E PCI network interface driver

config DEBUG_E1000E_PCI
    bool "Debug E1000E PCI"
    depends on DEBUG_PRINTS && E1000E_PCI
    default n
    help
      Turn on debug prints for the E1000E PCI driver

config MLX3_PCI
    bool "Mellanox ConnectX-3 PCI Driver"
    depends on HAS_PCI
    default n
    help
      Adds experimental driver for the Mellanox ConnectX-3 HCA Adapter

config DEBUG_MLX3_PCI
    bool "Debug Mellanox ConnectX-3"
    depends on DEBUG_PRINTS && MLX3_PCI
    default n
    help
      Turn on debug prints for the Mellanox ConnectX-3 HCA Driver


config RAMDISK
    bool "RAM Disk Support"
    default n
    help 
       Adds the ramdisk device

config RAMDISK_EMBED
    bool "Embed nautilus/ramdisk.img and instantiate at boot"
    depends on RAMDISK
    default n
    help
      Embed the ramdisk image in the main directory
      into the Nautilus kernel image

config DEBUG_RAMDISK
    bool "Debug RAM Disk"
    depends on DEBUG_PRINTS && RAMDISK
    default n
    help
      Turn on debug prints for the ramdisk device

config ATA
    bool "ATA Support"
    depends on ARCH_X86
    default n
    help 
       Adds very primitive ATA suppor 
       Currently legacy controller only, HDs only, 
       and PIO only with LBA48

config DEBUG_ATA
    bool "Debug ATA Support"
    depends on DEBUG_PRINTS && ATA
    default n
    help
      Turn on debug prints for ATA devices

config VESA
    bool "VESA Support"
    depends on REAL_MODE_INTERFACE
    default n
    help
       Allow text and graphics control on VESA video cards

config DEBUG_VESA
    bool "Debug VESA"
    depends on VESA
    default n
    help
       Add debugging output from VESA driver

config NVME
    bool "NVME Support"
    depends on ARCH_X86
    default n
    help 
       Adds work in progress NVME driver

config DEBUG_NVME
    bool "Debug NVME Support"
    depends on DEBUG_PRINTS && NVME
    default n
    help
      Turn on debug prints for NVME devices

endmenu

    
```
